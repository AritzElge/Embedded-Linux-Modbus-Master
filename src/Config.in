## src/Config.in
```kconfig
# ~/projects/my_buildroot_external/Config.in
source "package/ELI_galileo/Config.in"
```

## src/package/ELI_galileo/Config.in
```kconfig
config BR2_PACKAGE_ELI_GALILEO
    bool "ELI_galileo software suite"
    help
      Contains all custom software for the Galileo project (C binary, scripts, JSON).
```
